## conf/distro/supadata.conf
```bitbake
MAINTAINER = "Kamil Piekutowski<influence1982@gmail.com>"

require conf/distro/poky.conf

DISTRO = "supadata"
DISTRO_NAME = "SUPADATA LLC"
DISTRO_VERSION = "1.0"
DISTRO_CODENAME = "warrior"
SDK_VENDOR = "-supadata"
SDK_VERSION = "sdkversion"

# Package management
EXTRA_IMAGE_FEATURES += " package-management "
PACKAGE_CLASSES_append  ?= " package_ipk"
IMAGE_INSTALL_append = " opkg"
PRSERV_HOST = "localhost:0"

PACKAGE_FEED_URIS = "http://192.168.137.1:8080"
PACKAGE_FEED_BASE_PATHS = ""
PACKAGE_FEED_ARCHS = "cortexa72 all raspberrypi4_64_supadata"


# Set hostname
hostname_pn-base-files = "supadata"

# Using systemd
DISTRO_FEATURES += "systemd"
VIRTUAL-RUNTIME_init_manager = "systemd"
DISTRO_FEATURES_remove +="sysvinit"
VIRTUAL-RUNTIME_initscripts = "systemd-compat-units"
DISTRO_FEATURES_BACKFILL_CONSIDERED += "sysvinit"

# Unneeded features
DISTRO_FEATURES_remove += "bluetooth wifi ext2 irda pcmia 3g nfc multiarch wayland pulseaudio bluez5"
DISTRO_FEATURES += "ldconfig"

KERNEL_DEVICETREE_append = " \
    overlays/audioinjector-wm8731-audio.dtbo \
    overlays/audioinjector-ultra.dtbo \
    overlays/audioinjector-addons.dtbo \
    overlays/i2c-mux.dtbo \
"
```

## conf/layer.conf
```bitbake
# We have a conf and classes directory, add to BBPATH
BBPATH .= ":${LAYERDIR}"

# We have recipes-* directories, add to BBFILES
BBFILES += "${LAYERDIR}/recipes-*/*/*.bb \
            ${LAYERDIR}/recipes-*/*/*.bbappend"

BBFILE_COLLECTIONS += "meta-supadata"
BBFILE_PATTERN_meta-supadata = "^${LAYERDIR}/"
BBFILE_PRIORITY_meta-supadata = "6"

LAYERDEPENDS_meta-supadata = " \
    core \
    openembedded-layer \
"
LAYERSERIES_COMPAT_meta-supadata = "hardknott"
```

## conf/machine/raspberrypi3-64-supadata.conf
```bitbake
#@TYPE: RaspberryPi 3 - Supadata LLC
#@NAME: RaspberryPi 3 - Supadata LLC (64 bit)
#@DESCRIPTION: Machine configuration for the RaspberryPi 3 in 64 bits mode for Supadata LLC

MACHINEOVERRIDES = "raspberrypi3:${MACHINE}"

MACHINE_EXTRA_RRECOMMENDS += "\
    linux-firmware-rpidistro-bcm43430 \
    linux-firmware-rpidistro-bcm43455 \
    bluez-firmware-rpidistro-bcm43430a1-hcd \
    bluez-firmware-rpidistro-bcm4345c0-hcd \
"

require conf/machine/include/tune-cortexa53.inc
include conf/machine/include/rpi-base.inc

RPI_KERNEL_DEVICETREE = " \
    broadcom/bcm2710-rpi-3-b.dtb \
    broadcom/bcm2710-rpi-3-b-plus.dtb \
    broadcom/bcm2837-rpi-3-b.dtb \
    "

SERIAL_CONSOLES ?= "115200;ttyS0"

UBOOT_MACHINE = "rpi_3_config"

# When u-boot is enabled we need to use the "Image" format and the "booti"
# command to load the kernel
KERNEL_IMAGETYPE_UBOOT ?= "Image"
# "zImage" not supported on arm64 and ".gz" images not supported by bootloader yet
KERNEL_IMAGETYPE_DIRECT ?= "Image"
KERNEL_BOOTCMD ?= "booti"

ARMSTUB ?= "armstub8.bin"

# Rpi pin-header connectivity
ENABLE_UART = "1"
ENABLE_I2C = "1"
ENABLE_SPI_BUS = "1"
GMU_MEM = "16"
DISABLE_SPLASH = "1"
FISABLE_RPI_BOOT_LOGO = "1"

KERNEL_MODULE_AUTOLOAD += "i2c-dev"
```

## conf/machine/raspberrypi3-supadata.conf
```bitbake
#@TYPE: RaspberryPi 3 - Supadata LLC
#@NAME: RaspberryPi 3 - Supadata LLC (32bit)
#@DESCRIPTION: Machine configuration for the RaspberryPi 3 in 32 bits mode for Supadata LLC

MACHINEOVVERIDE =. "raspberrypi3:"

DEFAULTTUNE ?= "cortexa7thf-neon-vfpv4"
require conf/machine/include/tune-cortexa7.inc
include conf/machine/include/rpi-base.inc

MACHINE_EXTRA_RRECOMMENDS += "\
    linux-firmware-rpidistro-bcm43430 \
    linux-firmware-rpidistro-bcm43455 \
    bluez-firmware-rpidistro-bcm43430a1-hcd \
    bluez-firmware-rpidistro-bcm4345c0-hcd \
"

SDIMG_KERNELIMAGE ?= "kernel7.img"
UBOOT_MACHINE = "rpi_3_32b_config"
SERIAL_CONSOLES ?= "115200;ttyS0"

ARMSTUB ?= "armstub7.bin"

# Rpi pin-header connectivity
ENABLE_UART = "1"
ENABLE_I2C = "1"
ENABLE_SPI_BUS = "1"
GMU_MEM = "16"
DISABLE_SPLASH = "1"
FISABLE_RPI_BOOT_LOGO = "1"

KERNEL_MODULE_AUTOLOAD += "i2c-dev"
```

## conf/machine/raspberrypi4-supadata.conf
```bitbake
#@TYPE: RaspberryPi 4 - Supadata LLC
#@NAME: RaspberryPi 4 - Supadata LLC (32bit)
#@DESCRIPTION: Machine configuration for the RaspberryPi 4 in 32 bits mode for Supadata LLC

MACHINEOVVERIDE =. "raspberrypi4:"


DEFAULTTUNE ?= "cortexa7thf-neon-vfpv4"
require conf/machine/include/tune-cortexa7.inc
include conf/machine/include/rpi-base.inc

MACHINE_EXTRA_RRECOMMENDS += "\
    linux-firmware-rpidistro-bcm43455 \
    bluez-firmware-rpidistro-bcm4345c0-hcd \
"

# 'l' stands for LPAE
SDIMG_KERNELIMAGE ?= "kernel7l.img"
UBOOT_MACHINE = "rpi_4_32b_config"
SERIAL_CONSOLES ?= "115200;ttyS0"

VC4DTBO ?= "vc4-fkms-v3d"
ARMSTUB ?= "armstub7.bin"

# Rpi pin-header connectivity
ENABLE_UART = "1"
ENABLE_I2C = "1"
ENABLE_SPI_BUS = "1"
GMU_MEM = "16"
DISABLE_SPLASH = "1"
FISABLE_RPI_BOOT_LOGO = "1"

KERNEL_MODULE_AUTOLOAD += "i2c-dev"
```
